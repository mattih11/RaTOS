## Kconfig
```kconfig
mainmenu "RaTOS Real-Time OS"

config KAS_INCLUDE_MAIN
        string
        default "kas.yaml"

config KAS_BUILD_SYSTEM
        string
        default "isar"

choice
        prompt "Target"
        default TARGET_ODROID_H4

config TARGET_ODROID_H4
        bool "Odroid H4 (Intel Alder Lake-N, amd64 EFI)"

config TARGET_CONTAINER_AMD64
        bool "Developer container image (amd64 docker-archive + QEMU ext4)"
        help
          Builds ratos-dev-image for the container-amd64 machine.
          Produces:
            - docker-archive.gz  (Docker rootfs, load with podman/docker)
            - vmlinuz / initrd.img  (EVL kernel + initrd, separate files)
            - ext4  (raw ext4 rootfs, used by scripts/start-qemu.sh directly)
            - wic.gz  (wic disk image with partition table, for CI releases)
          Boot locally:
            ./scripts/start-qemu.sh

endchoice

config KAS_INCLUDE_TARGET
        string
        default "kas/board/odroid-h4.yaml"       if TARGET_ODROID_H4
        default "kas/board/container-amd64.yaml"  if TARGET_CONTAINER_AMD64

if TARGET_ODROID_H4

choice
        prompt "Image type"
        default IMAGE_SWUPDATE

config IMAGE_SWUPDATE
        bool "Production image with SWUpdate OTA (A/B rootfs, EFI Boot Guard)"
        help
          Produces a .wic for initial flashing and a .swu for OTA updates.
          Uses EFI Boot Guard for A/B slot switching with watchdog rollback.
          Recommended for real deployments.

config IMAGE_SINGLE_ROOT
        bool "Development image (single-root, no OTA)"
        help
          Single-slot ext4 rootfs, EFI Boot Guard, expands partition on first boot.
          Simpler for development but does not support OTA updates.

endchoice

config KAS_INCLUDE_IMAGE_TYPE
        string
        default "kas/opt/swupdate.yaml" if IMAGE_SWUPDATE

endif   # TARGET_ODROID_H4

if TARGET_CONTAINER_AMD64

config BUILD_SDK
        bool "Build cross-compilation SDK"
        help
          After building the rootfs, builds a cross-compilation SDK that lets
          you compile CommRaT (and other packages) on your host machine,
          targeting the EVL sysroot.  The SDK includes:
            - x86_64 → amd64 cross-toolchain (gcc, g++, binutils, sysroot)
            - EVL kernel headers  (linux-headers-xenomai-4)
            - libevl headers and static/shared libraries

          Build the SDK:
            kas-container --isar build \
              kas.yaml:kas/board/container-amd64.yaml \
              -- -c populate_sdk ratos-dev-image

          The SDK installer is written to build/tmp/deploy/sdk/ (or
          build/tmp/deploy/images/container-amd64/).
          See docs/commrat-dev-guide.md for the full cross-compile workflow.

endif   # TARGET_CONTAINER_AMD64
```

## conf/layer.conf
```bitbake
#
# RaTOS Real-Time OS
#
# SPDX-License-Identifier: GPL-3.0-or-later
#

BBPATH .= ":${LAYERDIR}"

BBFILES += "${LAYERDIR}/recipes-*/*/*.bb \
            ${LAYERDIR}/recipes-*/*/*.bbappend"

BBFILE_COLLECTIONS += "ratos"
BBFILE_PATTERN_ratos = "^${LAYERDIR}/"
BBFILE_PRIORITY_ratos = "7"

LAYERSERIES_COMPAT_ratos = "next"

LAYERDIR_ratos = "${LAYERDIR}"
LAYERDIR_ratos[vardepvalue] = "ratos"
```

## conf/machine/container-amd64.conf
```bitbake
#
# RaTOS Real-Time OS — Developer container machine
#
# Mirrors isar/meta-isar/conf/machine/container-amd64.conf but lives in
# the RaTOS layer so meta-isar does not need to be added as a bblayers entry.
#
# SPDX-License-Identifier: GPL-3.0-or-later
#

DISTRO_ARCH = "amd64"

# Produce the Docker rootfs archive (primary output), a raw ext4 image for
# QEMU local boot, and a compressed wic image for release artifacts.
# The ext4 approach matches upstream xenomai-images/qemu-machine.inc:
#   boot with -device ide-hd and root=/dev/sda. CONFIG_SATA_AHCI=y so the
#   AHCI driver is built in — no initramfs injection needed.
#   Use a single console=ttyS0 (no console=tty0) so systemd-getty-generator
#   auto-starts serial-getty@ttyS0 and ttyS0 is /dev/console.
IMAGE_FSTYPES ?= "docker-archive.gz ext4 wic.gz"

# Boot the ext4 image with (see scripts/start-qemu.sh):
#   qemu-system-x86_64 \
#     -kernel vmlinuz -initrd initrd.img \
#     -drive file=ratos-dev-image-container-amd64.ext4 \
#     -device ide-hd,drive=disk \
#     -append "root=/dev/sda rw console=ttyS0,115200 console=tty0"
# The ratos distro sets WKS_FILE to ${MACHINE}.wks for the wic.gz artifact.

MACHINE_SERIAL ?= "ttyS0"
BAUDRATE_TTY   ?= "115200"
```

## conf/machine/odroid-h4.conf
```bitbake
#
# RaTOS Real-Time OS
#
# SPDX-License-Identifier: GPL-3.0-or-later
#
# Odroid H4 / H4 Plus (Intel Alder Lake-N N97, x86-64 EFI).
# Uses EFI Boot Guard (efibootguard from isar-cip-core) as bootloader.
# EBG handles both single-root development builds and A/B SWUpdate OTA builds.
#

DISTRO_ARCH = "amd64"

IMAGE_FSTYPES ?= "wic wic.gz"

# EFI Boot Guard – required by both single-root (odroid-h4.wks) and
# A/B SWUpdate (odroid-h4-efibootguard.wks.in) layouts.
# The efibootguard-boot wic plugin copies the kernel into the BOOT partition.
IMAGER_INSTALL:wic += "efibootguard:${DISTRO_ARCH} efibootguard-tools:${DISTRO_ARCH}"

# EFI Boot Guard wic plugin variables
EFI_ARCH = "x64"
EFI_LIB_ARCH = "x86_64-linux-gnu"
WDOG_TIMEOUT ?= "60"
WICVARS += "EFI_ARCH EFI_LIB_ARCH WDOG_TIMEOUT KERNEL_IMAGE INITRD_DEPLOY_FILE"

# factory-reset-helper variant for EFI machines (provided by isar-cip-core)
PREFERRED_PROVIDER_factory-reset-helper = "factory-reset-helper-efi"
```

## wic/container-amd64.wks
```
# QEMU-bootable disk image for container-amd64
#
# Single ext4 partition (no bootloader). Boot with:
#   qemu-system-x86_64 \
#     -kernel vmlinuz -initrd initrd.img \
#     -hda ratos-dev-image-container-amd64.wic \
#     -append "root=LABEL=root rw console=ttyS0,115200 console=tty0"
#
# SPDX-License-Identifier: GPL-3.0-or-later

part / --source rootfs --fstype=ext4 --label root --align 4096 --size 4G

bootloader
```

## wic/odroid-h4.wks
```
#
# RaTOS Real-Time OS
#
# SPDX-License-Identifier: GPL-3.0-or-later
#
# Odroid H4 — single-root disk layout (development / first-boot)
# Uses EFI Boot Guard (single slot, no A/B).
# For production OTA builds use: kas/opt/swupdate.yaml → odroid-h4-efibootguard.wks.in
#

# EBG binary lives in the EFI system partition
part --source efibootguard-efi --fixed-size 16M --label efi --align 1024 --part-type=EF00 --active --fsuuid 0x4321dcba --uuid c19e7e9f-bacf-49a6-b43d-2fc18d2a8d03

# EBG config + kernel/initrd (single slot, revision=1)
part --source efibootguard-boot --fixed-size 128M --label BOOT --align 1024 --part-type=0700 --sourceparams "revision=1"

# Root filesystem (ext4, partition-expand-on-first-boot enabled)
part / --source rootfs --ondisk sda --fstype ext4 --label platform --align 1024 --use-uuid

bootloader --ptable gpt --timeout=2 --append "rw rootwait console=ttyS0,115200 console=tty0"
```
